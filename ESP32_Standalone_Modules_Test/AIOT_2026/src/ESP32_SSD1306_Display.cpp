#include "ESP32_SSD1306_Display.h"

static uint8_t OLED_Buffer[OLED_WIDTH * OLED_HEIGHT / 8];
static uint8_t Current_X, Current_Y;

static const uint8_t Font5x7[95][5] = {
  {0x00,0x00,0x00,0x00,0x00}, // 32 space
  {0x00,0x00,0x5F,0x00,0x00}, // 33 !
  {0x00,0x07,0x00,0x07,0x00}, // 34 "
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  {0x08,0x04,0x08,0x10,0x08}, //126 ~
};

static bool OLED_Write(uint8_t control, uint8_t data){
    Wire.beginTransmission(OLED_I2C_ADDR);
    Wire.write(control);
    Wire.write(data);
    return Wire.endTransmission() == 0;
}

static bool OLED_SendCommand(uint8_t cmd){
    return OLED_Write(0x00, cmd);
}

bool OLED_Init(void){
    static const uint8_t initCommands[] = {
        0xAE, 0x20, 0x00, 0xB0, 0xC8, 0x00, 0x10, 0x40,
        0x81, 0x7F, 0xA1, 0xA6, 0xA8, OLED_HEIGHT - 1,
        0xA4, 0xD3, 0x00, 0xD5, 0x80, 0xD9, 0xF1, 0xDA,
        0x12, 0xDB, 0x40, 0x8D, 0x14, 0xAF
    };

    for(uint8_t command : initCommands){
        if(!OLED_SendCommand(command)){
            return false;
        }
    }

    OLED_Clear_Display();
    return OLED_UpdateScreen();
}

void OLED_Clear_Display(void){
    memset(OLED_Buffer, 0x00, sizeof(OLED_Buffer));
}

bool OLED_UpdateScreen(void){
    static const uint8_t CHUNK_SIZE = 16;

    for(uint8_t page = 0 ; page < (OLED_HEIGHT / 8) ; page++){
        if(!OLED_SendCommand(0xB0 + page) ||
           !OLED_SendCommand(0x00) ||
           !OLED_SendCommand(0x10)){
            return false;
        }

        for(uint8_t x = 0 ; x < OLED_WIDTH ; x += CHUNK_SIZE){
            Wire.beginTransmission(OLED_I2C_ADDR);
            size_t controlWritten = Wire.write(0x40);
            size_t written = Wire.write(
                &OLED_Buffer[OLED_WIDTH * page + x],
                CHUNK_SIZE
            );
            uint8_t error = Wire.endTransmission();

            if(controlWritten != 1 || written != CHUNK_SIZE || error != 0){
                return false;
            }
        }
    }

    return true;
}

void OLED_GotoXY(uint8_t x, uint8_t y){
    Current_X = x;
    Current_Y = y;
}

void OLED_DrawPixel(uint8_t x, uint8_t y, bool color){
    if(x >= OLED_WIDTH || y >= OLED_HEIGHT) return;

    if(color){
        OLED_Buffer[x + (y / 8) * OLED_WIDTH] |= (1 << (y % 8));
    } else {
        OLED_Buffer[x + (y / 8) * OLED_WIDTH] &= ~(1 << (y % 8));
    }
}


void OLED_Println(const char* str){
    if(str == nullptr){
        return;
    }

    while(*str){
        char c = *str++;

        if(c == '\n'){
            Current_X = 0;
            Current_Y += 8;
            continue;
        }

        if(c < 32 || c > 126) c = '?';

        if(Current_X > OLED_WIDTH - 5){
            Current_X = 0;
            Current_Y += 8;
        }

        if(Current_Y > OLED_HEIGHT - 8){
            return;
        }

        for(int i = 0 ; i < 5 ; i++){
            uint8_t line = Font5x7[c - 32][i];

            for(int j = 0 ; j < 8 ; j++){
                OLED_DrawPixel(Current_X + i, Current_Y + j, (line >> j) & 1);
            }
        }
        Current_X += 6;
    }
}

void OLED_Printf(const char* format, ...){
    if(format == nullptr){
        return;
    }

    char buffer[64];

    va_list args;
    va_start(args, format);
    vsnprintf(buffer, sizeof(buffer), format, args);
    va_end(args);
    
    // Gửi chuỗi đã format hoàn chỉnh xuống hàm vẽ
    OLED_Println(buffer);
}

// ==== TEST MAIN ====
void OLED_TestSetup(void){
    if(!OLED_Init()){
        Serial.println("[ERR] Khong tim thay OLED SSD1306!");
        return;
    }

    // Reset buffer
    OLED_Clear_Display();

    // Test in text tĩnh
    OLED_GotoXY(0, 0);
    OLED_Println("He thong IoT SGP30");

    // Test in số thực (float) và số nguyên (int) với OLED_Printf
    float test_co2 = 1205.54;
    int test_tvoc = 45;
    
    OLED_GotoXY(0, 16);
    OLED_Printf("CO2 : %.2f ppm\nTVOC: %d ppb", test_co2, test_tvoc);

    OLED_UpdateScreen();
}
